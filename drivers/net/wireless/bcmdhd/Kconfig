## drivers/net/wireless/bcmdhd/Kconfig
```kconfig
config BCMDHD
	tristate "Broadcom FullMAC wireless cards support"
	---help---
	  This module adds support for wireless adapters based on
	  Broadcom FullMAC chipset.

	  If you choose to build a module, it'll be called dhd. Say M if
	  unsure.

config BCMDHD_SDIO
	bool "SDIO bus interface support"
	depends on BCMDHD && MMC

config BCMDHD_PCIE
	bool "PCIe bus interface support"
	depends on BCMDHD && PCI && !BCMDHD_SDIO

config BCM4354
	tristate "BCM4354 support"
	depends on BCMDHD

config BCM4356
	tristate "BCM4356 support"
	depends on BCMDHD
	default n

config BCM4358
	tristate "BCM4358 support"
	depends on BCMDHD
	default n

config BCMDHD_FW_PATH
	depends on BCMDHD
	string "Firmware path"
	default "/system/vendor/firmware/fw_bcmdhd.bin"
	---help---
	  Path to the firmware file.

config BCMDHD_NVRAM_PATH
	depends on BCMDHD
	string "NVRAM path"
	default "/system/etc/wifi/bcmdhd.cal"
	---help---
	  Path to the calibration file.

config DHD_USE_STATIC_BUF
	bool "Enable memory preallocation"
	depends on BCMDHD
	default n
	---help---
	  Use memory preallocated in platform

config DHD_USE_SCHED_SCAN
	bool "Use CFG80211 sched scan"
	depends on BCMDHD && CFG80211
	default n
	---help---
	  Use CFG80211 sched scan

config DHD_SET_RANDOM_MAC_VAL
	hex "Vendor OUI"
	depends on BCMDHD
	default 0x001A11
	---help---
	  Set vendor OUI for SoftAP

config DHD_OF_SUPPORT
	bool "Use in-drive platform device"
	depends on BCMDHD
	default n

config BCMDHD_MONITOR_MODE
	bool "Native 802.11 monitor mode and frame injection"
	depends on BCMDHD && CFG80211
	default n
	---help---
	  Enable native cfg80211/nl80211 monitor mode support for the
	  Broadcom FullMAC driver. This exposes a standard monitor
	  interface (created via "iw"/airmon-ng) instead of requiring the
	  nexmon userspace wrapper. Received 802.11 frames are delivered
	  with a radiotap header, and raw frames written to the monitor
	  interface (e.g. by aireplay-ng) are injected for all frame types.

	  The completeness of monitor RX and frame injection ultimately
	  depends on the capabilities of the loaded firmware: stock
	  firmware offers partial support, while a monitor/injection
	  capable (e.g. nexmon-patched) firmware enables full operation.

	  Say N if unsure.
```
